## package/qt5/qt5quick3d/Config.in
```kconfig
config BR2_PACKAGE_QT5QUICK3D
	bool "qt5quick3d"
	depends on BR2_PACKAGE_HAS_LIBGL || BR2_PACKAGE_HAS_LIBGLES
	select BR2_PACKAGE_QT5DECLARATIVE
	select BR2_PACKAGE_QT5DECLARATIVE_QUICK
	help
	  Qt5Quick3D module provides a high-level API for creating 
	  3D content or GFX in Qt Quick.

	  https://doc.qt.io/qt-5/qtquick3d-index.html

comment "qt5quick3d needs OpenGL or GLES"
    depends on !(BR2_PACKAGE_HAS_LIBGL || BR2_PACKAGE_HAS_LIBGLES)
```
