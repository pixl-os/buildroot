## package/qt6/qt6imageformats/Config.in
```kconfig
config BR2_PACKAGE_QT6IMAGEFORMATS
	bool "qt6imageformats"
	select BR2_PACKAGE_QT6BASE_GUI
	help
	  Qt is a cross-platform application and UI framework for
	  developers using C++.

	  The core Qt Gui library by default supports reading and writing image files of the most common file formats: PNG, JPEG, BMP, GIF and a few more, ref. Reading and Writing Image Files. The Qt Image Formats add-on module provides optional support for other image file formats.
	  
	  https://doc.qt.io/qt-6/qtimageformats-index.html
```

## package/vulkan-headers/Config.in
```kconfig
config BR2_PACKAGE_VULKAN_HEADERS
	bool "vulkan-headers"
	depends on BR2_PACKAGE_VULKAN_TOOLS
	depends on BR2_PACKAGE_VULKAN_LOADER
	depends on BR2_PACKAGE_VULKAN_SAMPLES
	help
	  The Khronos official Vulkan header files and API
	  registry.

	  https://github.com/KhronosGroup/Vulkan-Headers
```
